## drivers/clk/qcom/mdss/Kconfig
```kconfig
# SPDX-License-Identifier: GPL-2.0-only

config MDSS_PLL
	bool "MDSS pll programming"
	depends on COMMON_CLK_QCOM
	help
	  It provides support for DSI, eDP and HDMI interface pll programming on MDSS
	  hardware. It also handles the pll specific resources and turn them on/off
	  when mdss pll client tries to enable/disable pll clocks.

config MDSS_PLL_12NM
	bool "MDSS 12NM pll"
	depends on MDSS_PLL
	help
	  It provides support for SoCs with 12nm node.

config MDSS_PLL_14NM
	bool "MDSS 14NM pll"
	depends on MDSS_PLL
	help
	  It provides support for SoCs with 14nm node.

config MDSS_PLL_28NM
	bool "MDSS 28NM pll"
	depends on MDSS_PLL
	help
	  It provides support for SoCs with 28nm node.
```

## drivers/input/touchscreen/focaltech_d9_d9p/Kconfig
```kconfig
#
# Focaltech Touchscreen driver configuration
#

config TOUCHSCREEN_FTS_D9_D9P
	bool "Focaltech Touchscreen"
	depends on I2C
	default n
	help
	  Say Y here if you have Focaltech touch panel.
	  If unsure, say N.

config TOUCHSCREEN_FTS_DIRECTORY_D9_D9P
	string "Focaltech ts directory name"
	default "focaltech_touch"
	depends on TOUCHSCREEN_FTS
```

## techpack/audio/Kconfig
```kconfig
menu "Techpack audio options"

config AFE_HWDEP
	tristate "AFE_HWDEP"
config AUDIO_EXT_CLK
	tristate "AUDIO_EXT_CLK"
config DOLBY_DS2
	tristate "DOLBY_DS2"
config DOLBY_LICENSE
	tristate "DOLBY_LICENSE"
config DTS_EAGLE
	tristate "DTS_EAGLE"
config DTS_SRS_TM
	tristate "DTS_SRS_TM"
config MSM_ADSP_LOADER
	tristate "MSM_ADSP_LOADER"
config MSM_AVTIMER
	tristate "MSM_AVTIMER"
config AVTIMER_LEGACY
	tristate "AVTIMER_LEGACY"
config MSM_CDC_PINCTRL
	tristate "MSM_CDC_PINCTRL"
config MSM_GLINK_SPI_XPRT
	tristate "MSM_GLINK_SPI_XPRT"
config MSM_MDF
	tristate "MSM_MDF"
config MSM_QDSP6_APRV2_GLINK
	tristate "MSM_QDSP6_APRV2_GLINK"
config MSM_QDSP6_APRV2_RPMSG
	tristate "MSM_QDSP6_APRV2_RPMSG"
config MSM_QDSP6_APRV3_GLINK
	tristate "MSM_QDSP6_APRV3_GLINK"
config MSM_QDSP6_NOTIFIER
	tristate "MSM_QDSP6_NOTIFIER"
config MSM_QDSP6_PDR
	tristate "MSM_QDSP6_PDR"
config MSM_QDSP6_SSR
	tristate "MSM_QDSP6_SSR"
config MSM_QDSP6V2_CODECS
	tristate "MSM_QDSP6V2_CODECS"
config MSM_ULTRASOUND
	tristate "MSM_ULTRASOUND"
config PINCTRL_LPI
	tristate "PINCTRL_LPI"
config PINCTRL_LPI_LEGACY
	tristate "PINCTRL_LPI_LEGACY"
config PINCTRL_WCD
	tristate "PINCTRL_WCD"
config QTI_PP
	tristate "QTI_PP"
config REGMAP_SWR
	tristate "REGMAP_SWR"
config RX_MACRO
	tristate "RX_MACRO"
config SND_EVENT
	tristate "SND_EVENT"
config SND_HWDEP_ROUTING
	tristate "SND_HWDEP_ROUTING"
config SND_SOC_ANALOG_CDC
	tristate "SND_SOC_ANALOG_CDC"
config SND_SOC_BOLERO
	tristate "SND_SOC_BOLERO"
config SND_SOC_CPE
	tristate "SND_SOC_CPE"
config SND_SOC_CSRA66X0
	tristate "SND_SOC_CSRA66X0"
config SND_SOC_DIGITAL_CDC
	tristate "SND_SOC_DIGITAL_CDC"
config SND_SOC_EP92
	tristate "SND_SOC_EP92"
config SND_SOC_EXT_CODEC
	tristate "SND_SOC_EXT_CODEC"
config SND_SOC_FOR_ULTRASOUND_PATH
	tristate "SND_SOC_FOR_ULTRASOUND_PATH"
config SND_SOC_INT_CODEC
	tristate "SND_SOC_INT_CODEC"
config SND_SOC_MACHINE_SDXPOORWILLS
	tristate "SND_SOC_MACHINE_SDXPOORWILLS"
config SND_SOC_MSM_HDMI_CODEC_RX
	tristate "SND_SOC_MSM_HDMI_CODEC_RX"
config SND_SOC_MSM_HOSTLESS_PCM
	tristate "SND_SOC_MSM_HOSTLESS_PCM"
config SND_SOC_MSM_QDSP6V2_INTF
	tristate "SND_SOC_MSM_QDSP6V2_INTF"
config SND_SOC_MSM_SDW
	tristate "SND_SOC_MSM_SDW"
config SND_SOC_MSM_STUB
	tristate "SND_SOC_MSM_STUB"
config SND_SOC_POORWILLS
	tristate "SND_SOC_POORWILLS"
config SND_SOC_QCS405
	tristate "SND_SOC_QCS405"
config SND_SOC_QDSP6V2
	tristate "SND_SOC_QDSP6V2"
config SND_SOC_SDM660_CDC
	tristate "SND_SOC_SDM660_CDC"
config SND_SOC_SDM660
	tristate "SND_SOC_SDM660"
config SND_SOC_SDM670
	tristate "SND_SOC_SDM670"
config SND_SOC_SDM845
	tristate "SND_SOC_SDM845"
config SND_SOC_SM6150
	tristate "SND_SOC_SM6150"
config SND_SOC_SM8150
	tristate "SND_SOC_SM8150"
config SND_SOC_WCD9335
	tristate "SND_SOC_WCD9335"
config SND_SOC_WCD934X
	tristate "SND_SOC_WCD934X"
config SND_SOC_WCD934X_DSD
	tristate "SND_SOC_WCD934X_DSD"
config SND_SOC_WCD934X_MBHC
	tristate "SND_SOC_WCD934X_MBHC"
config SND_SOC_WCD9360
	tristate "SND_SOC_WCD9360"
config SND_SOC_WCD937X
	tristate "SND_SOC_WCD937X"
config SND_SOC_WCD937X_SLAVE
	tristate "SND_SOC_WCD937X_SLAVE"
config SND_SOC_WCD9XXX_V2
	tristate "SND_SOC_WCD9XXX_V2"
config SND_SOC_WCD_CPE
	tristate "SND_SOC_WCD_CPE"
config SND_SOC_WCD_DSP_MGR
	tristate "SND_SOC_WCD_DSP_MGR"
config SND_SOC_WCD_IRQ
	tristate "SND_SOC_WCD_IRQ"
config SND_SOC_WCD_MBHC
	tristate "SND_SOC_WCD_MBHC"
config SND_SOC_WCD_MBHC_ADC
	tristate "SND_SOC_WCD_MBHC_ADC"
config SND_SOC_WCD_MBHC_LEGACY
	tristate "SND_SOC_WCD_MBHC_LEGACY"
config SND_SOC_WCD_SPI
	tristate "SND_SOC_WCD_SPI"
config SND_SOC_WSA881X
	tristate "SND_SOC_WSA881X"
config SOUNDWIRE
	tristate "SOUNDWIRE"
config SOUNDWIRE_MSTR_CTRL
	tristate "SOUNDWIRE_MSTR_CTRL"
config SOUNDWIRE_WCD_CTRL
	tristate "SOUNDWIRE_WCD_CTRL"
config TFA_NON_DSP_SOLUTION
	tristate"TFA_NON_DSP_SOLUTION"
config TX_MACRO
	tristate "TX_MACRO"
config USE_Q6_32CH_SUPPORT
	tristate "USE_Q6_32CH_SUPPORT"
config VA_MACRO
	tristate "VA_MACRO"
config WCD9XXX_CODEC_CORE
	tristate "WCD9XXX_CODEC_CORE"
config WCD_DSP_GLINK
	tristate "WCD_DSP_GLINK"
config WSA_MACRO
	tristate "WSA_MACRO"
config SND_SOC_TAS2557
	tristate "Texas Instruments TAS2557 SmartAmp(R)"
if SND_SOC_TAS2557
config TAS2557_REGMAP
	bool "Use of RegMap API"
config TAS2557_CODEC
	bool "Codec Driver support"
config TAS2557_MISC
	bool "Misc Driver support"
endif # SND_SOC_TAS2557

config SND_SOC_TAS2557_STEREO
	tristate "Texas Instruments TAS2557 SmartAmp(R)"
if SND_SOC_TAS2557_STEREO
config TAS2557_REGMAP_STEREO
	bool "Use of RegMap API"
config TAS2557_CODEC_STEREO
	bool "Codec Driver support"
config TAS2557_MISC_STEREO
	bool "Misc Driver support"
endif # SND_SOC_TAS2557_STEREO

config SND_I2S_PRIMARY
	bool "Primary I2S Driver support"
config SND_SOC_MAX98937
	tristate "maxim Instruments 98937 SmartAmp(R)"
config ELLIPTICLABS
	tristate "Elliptic Labs fake proximity sensor support"
config SOUND_CONTROL
	bool "Sound Control for msm89xx"
config SND_SOC_USB_HEADSET
	tristate "Xiaomi USB analog headset driver"

endmenu
```
